## device/platform/esp32s3/main/Kconfig.projbuild
```kconfig
menu "MyToki"

    config MYTOKI_WIFI_SSID
        string "Wi-Fi network name"
        default ""

    config MYTOKI_WIFI_PASSWORD
        string "Wi-Fi password"
        default ""

    config MYTOKI_DAY_URL
        string "Day plan URL"
        default ""
        help
            HTTPS endpoint that returns today's plan as JSON (device/docs/day-plan.md).
            Leave empty to run the built-in demo day (platform/sim/web/demo/school-day.json).

    config MYTOKI_EVENTS_URL
        string "Events URL"
        default ""
        help
            HTTPS endpoint the device POSTs to when a task, chore or reward request happens.
            Leave empty to keep them on the device only.

    config MYTOKI_DEVICE_TOKEN
        string "Device token"
        default ""
        help
            Sent as "Authorization: Bearer <token>" with every request.

    config MYTOKI_DEMO_TIME
        string "Start time with no network (HH:MM)"
        default ""
        help
            With no network the clock starts from the firmware's build time. A time of day here starts
            it at that time today instead, to try a part of the demo day: 15:20 is after school, with
            Biscuit's room, the carousel and the day's sheet (school hours lock the carousel).

    config MYTOKI_TIMEZONE
        string "Time zone (POSIX TZ)"
        default "PST8PDT,M3.2.0,M11.1.0"
        help
            The household's time zone. The web app runs on Pacific time.

    config MYTOKI_BUTTON_GPIO
        int "GPIO of the button at 1 o'clock"
        default 0
        help
            The BOOT button (GPIO0) until the enclosure's own button is wired.

    config MYTOKI_SOUND
        bool "Chimes on the speaker"
        default y

    config MYTOKI_NO_SCHOOL
        bool "Test: no school mode (the day runs as if there were no School)"
        default n
        help
            For trying MyToki during school hours: the School row is left out of the day it gets,
            so those hours are ordinary time. Set it in the board's own sdkconfig, never for a child.

    config MYTOKI_IMU
        bool "Motion from the board's QMI8658 (the motion games)"
        default y
        help
            Reads the accelerometer over the board's I2C bus at 100 Hz and hands the samples
            to the app (mytoki_motion). The product swaps in a LIS2DH12 behind the same call.

endmenu
```
